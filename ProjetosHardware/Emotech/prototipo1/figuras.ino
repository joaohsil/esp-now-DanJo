/*
    Sketch Refatorado: Associação de Botões aos Bitmaps de Cria
    1. Botão Feliz (Pino 19)   -> Burgão de Cria
    2. Botão Triste (Pino 18)  -> Sanitário de Cria
    3. Botão Neutro (Pino 5)   -> Carro de Cria
*/

#include <Wire.h>
#include <Adafruit_GFX.h>
#include <Adafruit_SSD1306.h>

#define LARGURA_TELA 128 
#define ALTURA_TELA 64   
#define OLED_ADDR 0x3C

// Objeto do display (SDA = 21; SCL = 22 no ESP32 padrão)
Adafruit_SSD1306 display(LARGURA_TELA, ALTURA_TELA, &Wire, -1);

// --- BITMAPS DE CRIA (PROGMEM) ---

// 1. Burgão de Cria
const unsigned char burguer [] PROGMEM = {
  0xff, 0xff, 0xff, 0xff, 0xff, 0xff, 0xff, 0xff, 0xff, 0xff, 0xff, 0xff, 0xff, 0xff, 0xff, 0xff, 
  0xff, 0xff, 0xff, 0xff, 0xff, 0xff, 0xff, 0xff, 0xff, 0xff, 0xff, 0xff, 0xff, 0xff, 0xff, 0xff, 
  0xff, 0xff, 0xff, 0xff, 0xff, 0xff, 0xff, 0xff, 0xff, 0xff, 0xff, 0xff, 0xff, 0xff, 0xff, 0xff, 
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  0xff, 0xff, 0xff, 0xff, 0xff, 0xff, 0xff, 0xff, 0xff, 0xff, 0xff, 0xff, 0xff, 0xff, 0xff, 0xff
};

// 2. Sanitário de Cria
const unsigned char vaso [] PROGMEM = {
  0xff, 0xff, 0xff, 0xff, 0xff, 0xff, 0xff, 0xff, 0xff, 0xff, 0xff, 0xff, 0xff, 0xff, 0xff, 0xff, 
  0xff, 0xff, 0xff, 0xff, 0xff, 0xff, 0xff, 0xff, 0xff, 0xff, 0xff, 0xff, 0xff, 0xff, 0xff, 0xff, 
  0xff, 0xff, 0xff, 0xff, 0xff, 0xff, 0xff, 0xff, 0xff, 0xff, 0xff, 0xff, 0xff, 0xff, 0xff, 0xff, 
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  0xff, 0xff, 0xff, 0xff, 0xff, 0xff, 0xff, 0xff, 0xff, 0xff, 0xff, 0xff, 0xff, 0xff, 0xff, 0xff
};

// 3. Carro de Cria
const unsigned char carro [] PROGMEM = {
  0xff, 0xff, 0xff, 0xff, 0xff, 0xff, 0xf8, 0x00, 0x0f, 0xff, 0xff, 0xff, 0xff, 0xff, 0xff, 0xff, 
  0xff, 0xff, 0xff, 0xff, 0xff, 0xfe, 0x00, 0x00, 0x00, 0x7f, 0xff, 0xff, 0xff, 0xff, 0xff, 0xff, 
  0xff, 0xff, 0xff, 0xff, 0xff, 0xe0, 0x0f, 0xff, 0xf0, 0x0f, 0xff, 0xff, 0xff, 0xff, 0xff, 0xff, 
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  0xff, 0xff, 0xff, 0xff, 0xfe, 0x0f, 0xff, 0xff, 0xff, 0xff, 0xc1, 0xff, 0xff, 0xff, 0xff, 0xff
};

// --- CONFIGURAÇÃO DOS BOTÕES ---
const int btnFeliz = 19;
const int btnTriste = 18;
const int btnNeutro = 5;

// Variáveis do Debounce
unsigned long tempoUltimoFeliz = 0;
unsigned long tempoUltimoTriste = 0;
unsigned long tempoUltimoNeutro = 0;
const unsigned long atrasoDebounce = 50; 

int ultimoEstadoFeliz = HIGH;
int ultimoEstadoTriste = HIGH;
int ultimoEstadoNeutro = HIGH;

int telaAtual = 0; 

void setup() {
  Serial.begin(115200);

  pinMode(btnFeliz, INPUT_PULLUP);
  pinMode(btnTriste, INPUT_PULLUP);
  pinMode(btnNeutro, INPUT_PULLUP);

  // Inicializa o Display I2C
  if(!display.begin(SSD1306_SWITCHCAPVCC, OLED_ADDR)) {
    Serial.println("Falha no SSD1306");
    for(;;); 
  }

  // Tela Inicial Padrão (Texto Informativo antes do primeiro clique)
  display.clearDisplay();
  display.setTextColor(SSD1306_WHITE); 
  display.setTextSize(1);
  display.setCursor(15, 28);
  display.print("Aperte um botao...");
  display.display();
}

void loop() {
  int leituraFeliz = digitalRead(btnFeliz);
  int leituraTriste = digitalRead(btnTriste);
  int leituraNeutro = digitalRead(btnNeutro);

  // --- Debounce Feliz -> Exibe Burgão ---
  if (leituraFeliz != ultimoEstadoFeliz) tempoUltimoFeliz = millis();
  if ((millis() - tempoUltimoFeliz) > atrasoDebounce) {
    if (leituraFeliz == LOW && telaAtual != 1) {
      mostrarBitmap(burguer);
      telaAtual = 1;
    }
  }

  // --- Debounce Triste -> Exibe Vaso ---
  if (leituraTriste != ultimoEstadoTriste) tempoUltimoTriste = millis();
  if ((millis() - tempoUltimoTriste) > atrasoDebounce) {
    if (leituraTriste == LOW && telaAtual != 2) {
      mostrarBitmap(vaso);
      telaAtual = 2;
    }
  }

  // --- Debounce Neutro -> Exibe Carro ---
  if (leituraNeutro != ultimoEstadoNeutro) tempoUltimoNeutro = millis();
  if ((millis() - tempoUltimoNeutro) > atrasoDebounce) {
    if (leituraNeutro == LOW && telaAtual != 3) {
      mostrarBitmap(carro);
      telaAtual = 3;
    }
  }

  ultimoEstadoFeliz = leituraFeliz;
  ultimoEstadoTriste = leituraTriste;
  ultimoEstadoNeutro = leituraNeutro;
}

// Função para limpar, renderizar a imagem e atualizar o display
void mostrarBitmap(const unsigned char* bitmap) {
  display.clearDisplay(); 
  // Desenha o bitmap cobrindo toda a tela 128x64 começando da coordenada (0,0)
  display.drawBitmap(0, 0, bitmap, LARGURA_TELA, ALTURA_TELA, SSD1306_WHITE);
  display.display(); 
}